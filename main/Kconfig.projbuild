## main/Kconfig.projbuild
```kconfig
menu "Board Configuration"

    # ===== LED ==========================================================
    menu "LED Configuration"
        config LED_PIN
            int "LED PIN"
            default 2
        config LED_ACTIVE_LEVEL
            int "LED Active Level (0=Low, 1=High)"
            range 0 1
            default 0
    endmenu

    # ===== CTRL PINS ====================================================
    config EVENT_PIN
        int "Event Output GPIO"
        default 22

    config READY_PIN
        int "Ready Output GPIO"
        default 21

    # ===== QSPI Pins ====================================================
    menu "QSPI Pins"
        config SPI_SCK_PIN
            int "SCK GPIO"
            default 19
        config SPI_CS_PIN
            int "CS GPIO"
            default 20
        config SPI_D0_PIN
            int "D0 GPIO (MOSI)"
            default 18
        config SPI_D1_PIN
            int "D1 GPIO (MISO)"
            default 9
        config SPI_D2_PIN
            int "D2 GPIO (WP)"
            default -1
        config SPI_D3_PIN
            int "D3 GPIO (HD)"
            default -1
    endmenu

    # ===== WiFi ========================================================
    menu "WiFi Configuration"
        config ESP_PHY_MAX_WIFI_TX_POWER
            int "Maximum WiFi TX Power (dBm)"
            range 0 20
            default 20
            help
                Set maximum WiFi transmit power in dBm (0-20 dBm)
    endmenu

endmenu
```

## sdkconfig.defaults
```kconfig
# Default logging level used when building without changes in menuconfig.
# CONFIG_LOG_DEFAULT_LEVEL_NONE=y
# CONFIG_LOG_DEFAULT_LEVEL_ERROR=y
# CONFIG_LOG_DEFAULT_LEVEL_WARN=y
CONFIG_LOG_DEFAULT_LEVEL_INFO=y
# CONFIG_LOG_DEFAULT_LEVEL_DEBUG=y
# CONFIG_LOG_DEFAULT_LEVEL_VERBOSE=y

CONFIG_FREERTOS_HZ=1000
CONFIG_COMPILER_OPTIMIZATION_PERF=y

CONFIG_ESPTOOLPY_FLASHMODE_QIO=y
CONFIG_ESPTOOLPY_FLASHMODE="qio"
CONFIG_ESPTOOLPY_FLASHFREQ_80M=y
CONFIG_ESPTOOLPY_FLASHFREQ="80m"
CONFIG_ESPTOOLPY_FLASHSIZE_4MB=y
CONFIG_ESPTOOLPY_FLASHSIZE="4MB"

CONFIG_PARTITION_TABLE_CUSTOM=y
CONFIG_PARTITION_TABLE_FILENAME="partitions.csv"
CONFIG_PARTITION_TABLE_OFFSET=0x8000
CONFIG_PARTITION_TABLE_MD5=y
```

## sdkconfig.defaults.esp32
```kconfig
# ===== esp32_defaults =====

# --- LED ------------------------------------------------------------
CONFIG_LED_GPIO=2
CONFIG_LED_ACTIVE_LEVEL=0

# --- Interrupt ------------------------------------------------------
CONFIG_IRQ_OUT_PIN=21
CONFIG_IRQ_OUT_ACTIVE_LEVEL=0

# --- UARTs ----------------------------------------------------------
CONFIG_COM_UART_NUM=1
CONFIG_COM_USART_RX_PIN=16
CONFIG_COM_USART_TX_PIN=17

# --- SPI (generic slave interface) --------------------------------
CONFIG_COM_SPI_SLAVE=y
CONFIG_COM_SPI_NUM=3            
CONFIG_COM_SPI_MOSI_PIN=23      
CONFIG_COM_SPI_MISO_PIN=19      
CONFIG_COM_SPI_SCK_PIN=18       
CONFIG_COM_SPI_CS_PIN=5         

# --- SDIO (slave) --------------------------------------------------
CONFIG_COM_SDIO_SLAVE=y
CONFIG_COM_SDIO_CLK_PIN=14      
CONFIG_COM_SDIO_CMD_PIN=15      
CONFIG_COM_SDIO_D0_PIN=2        
CONFIG_COM_SDIO_D1_PIN=4        
CONFIG_COM_SDIO_D2_PIN=12       
CONFIG_COM_SDIO_D3_PIN=13       

# --- QSPI (slave) ---------------------------------------------------
CONFIG_COM_QSPI_SLAVE=n
#CONFIG_COM_QSPI_CS_PIN
#CONFIG_COM_QSPI_SCK_PIN
#CONFIG_COM_QSPI_IO0_PIN
#CONFIG_COM_QSPI_IO1_PIN
#CONFIG_COM_QSPI_IO2_PIN
#CONFIG_COM_QSPI_IO3_PIN
```

## sdkconfig.defaults.esp32c2
```kconfig
# ===== esp32-c2_defaults =====

# --- LED ------------------------------------------------------------
CONFIG_LED_GPIO=2
CONFIG_LED_ACTIVE_LEVEL=0

# --- Interrupt ------------------------------------------------------
CONFIG_IRQ_OUT_PIN=16
CONFIG_IRQ_OUT_ACTIVE_LEVEL=0

# --- UARTs ----------------------------------------------------------
CONFIG_CONSOLE_UART_NUM=0
CONFIG_COM_UART_NUM=1
CONFIG_COM_USART_RX_PIN=4
CONFIG_COM_USART_TX_PIN=5

# --- SPI (generic slave interface) --------------------------------
CONFIG_COM_SPI_SLAVE=y
CONFIG_COM_SPI_MOSI_PIN=13
CONFIG_COM_SPI_MISO_PIN=14
CONFIG_COM_SPI_SCK_PIN=15
CONFIG_COM_SPI_CS_PIN=16

# --- SDIO (slave) --------------------------------------------------
# ESP32-C2 does **not** include an SDIO slave controller; disable.
CONFIG_COM_SDIO_SLAVE=n
#CONFIG_COM_SDIO_CMD_PIN=
#CONFIG_COM_SDIO_CLK_PIN=
#CONFIG_COM_SDIO_D0_PIN=
#CONFIG_COM_SDIO_D1_PIN=
#CONFIG_COM_SDIO_D2_PIN=
#CONFIG_COM_SDIO_D3_PIN=

# --- QSPI (slave) ---------------------------------------------------
# ESP32-C2 has no QSPI slave support; disable.
CONFIG_COM_QSPI_SLAVE=n
#CONFIG_COM_QSPI_IO0_PIN=
#CONFIG_COM_QSPI_IO1_PIN=
#CONFIG_COM_QSPI_IO2_PIN=
#CONFIG_COM_QSPI_IO3_PIN=
#CONFIG_COM_QSPI_SCK_PIN=
#CONFIG_COM_QSPI_CS_PIN=

# Notes:
# adapt pins if board uses them for other functions
```

## sdkconfig.defaults.esp32c5
```kconfig
# --- LED ----------
CONFIG_LED_PIN=2
CONFIG_LED_ACTIVE_LEVEL=0

# --- Interrupt ----
CONFIG_IRQ_OUT_PIN=3

# --- MODE ----
CONFIG_MODE_PIN=13

# --- SPI ----------      
CONFIG_COM_SPI_SCK_PIN=0       
CONFIG_COM_SPI_CS_PIN=1  
CONFIG_COM_SPI_D0_MOSI_PIN=6      
CONFIG_COM_SPI_D1_MISO_PIN=7      
CONFIG_COM_SPI_D2_PIN=8
CONFIG_COM_SPI_D3_PIN=9
```

## sdkconfig.defaults.esp32c6
```kconfig
# --- LED ----------
CONFIG_LED_PIN=2
CONFIG_LED_ACTIVE_LEVEL=0

# --- Signal -------
CONFIG_EVENT_PIN=15
CONFIG_READY_PIN=23

# --- SPI ----------      
CONFIG_SPI_CS_PIN=22 
CONFIG_SPI_SCK_PIN=21       
CONFIG_SPI_D0_PIN=20      
CONFIG_SPI_D1_PIN=19      
CONFIG_SPI_D2_PIN=18      
CONFIG_SPI_D3_PIN=9      
```

## sdkconfig.defaults.esp32s2
```kconfig
# ===== esp32-s2_defaults =====

# --- LED ------------------------------------------------------------
CONFIG_LED_GPIO=2
CONFIG_LED_ACTIVE_LEVEL=0

# --- Interrupt ------------------------------------------------------
CONFIG_IRQ_OUT_PIN=21
CONFIG_IRQ_OUT_ACTIVE_LEVEL=0

# --- UARTs ----------------------------------------------------------
CONFIG_CONSOLE_UART_NUM=0
CONFIG_COM_UART_NUM=1
CONFIG_COM_USART_RX_PIN=16
CONFIG_COM_USART_TX_PIN=17

# --- SPI (generic slave interface) --------------------------------
CONFIG_COM_SPI_SLAVE=y
CONFIG_COM_SPI_MOSI_PIN=18
CONFIG_COM_SPI_MISO_PIN=19
CONFIG_COM_SPI_SCK_PIN=20
CONFIG_COM_SPI_CS_PIN=21

# --- SDIO (slave) --------------------------------------------------
# ESP32-S2 does not support SDIO slave; disable.
CONFIG_COM_SDIO_SLAVE=n
#CONFIG_COM_SDIO_CMD_PIN=
#CONFIG_COM_SDIO_CLK_PIN=
#CONFIG_COM_SDIO_D0_PIN=
#CONFIG_COM_SDIO_D1_PIN=
#CONFIG_COM_SDIO_D2_PIN=
#CONFIG_COM_SDIO_D3_PIN=

# --- QSPI (slave) ---------------------------------------------------
# ESP32-S2 does not support QSPI slave; disable.
CONFIG_COM_QSPI_SLAVE=n 
#CONFIG_COM_QSPI_IO0_PIN=
#CONFIG_COM_QSPI_IO1_PIN=
#CONFIG_COM_QSPI_IO2_PIN=
#CONFIG_COM_QSPI_IO3_PIN=
#CONFIG_COM_QSPI_SCK_PIN=
#CONFIG_COM_QSPI_CS_PIN=

# Notes:
# adjust if your board exposes different pins
```

## sdkconfig.defaults.esp32s3
```kconfig
# ===== esp32-s3_defaults =====

# --- LED ------------------------------------------------------------
CONFIG_LED_GPIO=2
CONFIG_LED_ACTIVE_LEVEL=0

# --- Interrupt ------------------------------------------------------
CONFIG_IRQ_OUT_PIN=21
CONFIG_IRQ_OUT_ACTIVE_LEVEL=0

# --- UARTs ----------------------------------------------------------
CONFIG_CONSOLE_UART_NUM=0
CONFIG_COM_UART_NUM=1
CONFIG_COM_USART_RX_PIN=16
CONFIG_COM_USART_TX_PIN=17

# --- SPI (generic slave interface) --------------------------------
CONFIG_COM_SPI_SLAVE=y
CONFIG_COM_SPI_MOSI_PIN=18
CONFIG_COM_SPI_MISO_PIN=19
CONFIG_COM_SPI_SCK_PIN=20
CONFIG_COM_SPI_CS_PIN=21

# --- SDIO (slave) --------------------------------------------------
# ESP32-S3 supports SDIO slave controller
CONFIG_COM_SDIO_SLAVE=y
CONFIG_COM_SDIO_CMD_PIN=28
CONFIG_COM_SDIO_CLK_PIN=29
CONFIG_COM_SDIO_D0_PIN=30
CONFIG_COM_SDIO_D1_PIN=31
CONFIG_COM_SDIO_D2_PIN=32
CONFIG_COM_SDIO_D3_PIN=33

# --- QSPI (slave) ---------------------------------------------------
# S3 also does not support QSPI slave (only QSPI flash)
CONFIG_COM_QSPI_SLAVE=n
#CONFIG_COM_QSPI_IO0_PIN=
#CONFIG_COM_QSPI_IO1_PIN=
#CONFIG_COM_QSPI_IO2_PIN=
#CONFIG_COM_QSPI_IO3_PIN=
#CONFIG_COM_QSPI_SCK_PIN=
#CONFIG_COM_QSPI_CS_PIN=

# Notes:
# adapt pins if board uses them for other functions
```
